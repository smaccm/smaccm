## models/GPS/Kconfig
```kconfig
config APP_GPS
    bool "A test app for the GPS"
    default n
    select APP_CAMKES_EXECUTIVE
    help
        A test app for the GPS. 
```

## models/Minitower/Kconfig
```kconfig
config APP_SMACCMPILOT
    bool "Smaccmpilot"
    depends on LIB_SEL4 && LIB_MUSL_C && LIB_SEL4_VKA && LIB_SEL4_ALLOCMAN && LIB_SEL4_PLAT_SUPPORT && \
            LIB_PLATSUPPORT && LIB_SEL4_VSPACE && LIB_ELF && LIB_SEL4_UTILS && LIB_SEL4_SIMPLE && \
            LIB_UTILS && LIB_SEL4_SIMPLE_DEFAULT && LIB_CPIO && LIB_SEL4_ARM_VMM && LIB_SEL4_SYNC && LIB_SEL4_DEBUG && \
            LIB_SEL4_DMA && LIB_USB
    default n
    select APP_CAMKES_EXECUTIVE
    select VM_VCHAN
    help
        Generated AADL from smaccmpilot

config VIRTUAL_MACHINE_EMMC2_NODMA
    bool "SD access control to prevent DMA"
    depends on APP_SMACCMPILOT && PLAT_EXYNOS5410
    default n
    help
        Installs SD card into the VM with read only access. Write access is
        trapped and emulated to ensure that DMA is not used.

config VIRTUAL_MACHINE_VUSB
    bool "Para-virtual USB driver"
    depends on APP_SMACCMPILOT && PLAT_EXYNOS5410
    help
        Selects the device tree which enables the para virtual USB driver and
        installs the device into the VM.

config VM_VCHAN
    bool "Enable vchan connection"
    depends on APP_SMACCMPILOT
    help
        Enable vchan connection.

choice
    bool "root file system selection"
    depends on APP_SMACCMPILOT && PLAT_EXYNOS5410
    default VM_ROOTFS_MMCBLK1P2
    help
        Selects the root device and partition which should be used for the
        root filesystem.

    config VM_ROOTFS_MMCBLK0P2
        bool "mmcblk0p2"
        help
            Selects partition 2 of the on board eMMC as the root filesystem.

    config VM_ROOTFS_MMCBLK1P2
        bool "mmcblk1p2"
        help
            Selects partition 2 of the on removable SD card as the root
            filesystem.

endchoice
```

## models/Minitower/make_template/Kconfig
```kconfig
config APP_SMACCMCOPTER
    bool "smaccmcopter (from AADL)"
    default n
    select APP_CAMKES_EXECUTIVE
    help
        smaccmcopter (from AADL).
```

## models/SmaccmPhaseIII/make_template/Kconfig
```kconfig
config APP_SMACCMPHASEIII
    bool "AADL generic message for implementation SmaccmPhaseIII"
    default n
    select APP_CAMKES_EXECUTIVE
    help
        AADL generic message for implementation SmaccmPhaseIII. 
```

## models/SmaccmPhaseIIIV2/Kconfig
```kconfig
config APP_SMACCMPHASEIIIV2
    bool "Generated code for SmaccmPhaseIII ."
    depends on LIB_SEL4 && LIB_MUSL_C && LIB_SEL4_VKA && LIB_SEL4_ALLOCMAN && LIB_SEL4_PLAT_SUPPORT && \
            LIB_PLATSUPPORT && LIB_SEL4_VSPACE && LIB_ELF && LIB_SEL4_UTILS && LIB_SEL4_SIMPLE && \
            LIB_UTILS && LIB_SEL4_SIMPLE_DEFAULT && LIB_CPIO && LIB_SEL4_ARM_VMM && LIB_SEL4_SYNC && LIB_SEL4_DEBUG && \
            LIB_SEL4_DMA && LIB_USB
    default n
    select APP_CAMKES_EXECUTIVE
    help
        Generated AADL from smaccmpilot

config VIRTUAL_MACHINE_EMMC2_NODMA
    bool "SD access control to prevent DMA"
    depends on APP_SMACCMPHASEIIIV2
    default n
    help
        Installs SD card into the VM with read only access. Write access is
        trapped and emulated to ensure that DMA is not used.

config VIRTUAL_MACHINE_VUSB
    bool "Para-virtual USB driver"
    depends on APP_SMACCMPHASEIIIV2
    help
        Selects the device tree which enables the para virtual USB driver and
        installs the device into the VM.

choice
    bool "root file system selection"
    depends on APP_SMACCMPHASEIIIV2
    default VIRTUAL_MACHINE_ROOTFS_MMCBLK1P2
    help
        Selects the root device and partition which should be used for the
        root filesystem.

    config SMACCMPHASEIIIV2_ROOTFS_MMCBLK0P2
        bool "mmcblk0p2"
        help
            Selects partition 2 of the on board eMMC as the root filesystem.

    config SMACCMPHASEIIIV2_ROOTFS_MMCBLK1P2
        bool "mmcblk1p2"
        help

endchoice
```

## models/SmaccmPhaseIIIV2/make_template/Kconfig
```kconfig
config APP_SMACCMPHASEIIIV2
    bool "AADL generic message for implementation SmaccmPhaseIIIV2"
    default n
    select APP_CAMKES_EXECUTIVE
    help
        AADL generic message for implementation SmaccmPhaseIIIV2. 
```

## models/Trusted_Build_Test/PingTwins/Kconfig
```kconfig
config APP_PINGTWINS
    bool "AADL Model where one active thread pings two passive threads simultaneously."
    default n
    select APP_CAMKES_EXECUTIVE
    help
    	AADL Model where one active thread pings two passive threads simultaneously.
```

## models/Trusted_Build_Test/PingTwinsActive/Kconfig
```kconfig
config APP_PINGTWINSACTIVE
    bool "AADL Model where one active thread pings two active threads simultaneously."
    default n
    select APP_CAMKES_EXECUTIVE
    help
    	AADL Model where one active thread pings two active threads simultaneously.
```

## models/Trusted_Build_Test/RonSwansons/Kconfig
```kconfig
config APP_RONSWANSONS
    bool "AADL Model that mitigates the dining philosophers problem using a resource hierarchy."
    default n
    select APP_CAMKES_EXECUTIVE
    help
        AADL Model that mitigates the dining philosophers problem using a resource hierarchy.
```

## models/Trusted_Build_Test/SwitchBasedComm/Kconfig
```kconfig
config APP_SWITCHBASEDCOMM
    bool "AADL Model where clients communicate through a switch."
    default n
    select APP_CAMKES_EXECUTIVE
    help
        AADL Model where clients communicate through a switch.
```

## models/Trusted_Build_Test/camera_vm/Kconfig
```kconfig
config APP_CAMERA_VM
    bool "Camera VM"
    depends on LIB_SEL4 && LIB_MUSL_C && LIB_SEL4_VKA && LIB_SEL4_ALLOCMAN && LIB_SEL4_PLAT_SUPPORT && \
            LIB_PLATSUPPORT && LIB_SEL4_VSPACE && LIB_ELF && LIB_SEL4_UTILS && LIB_SEL4_SIMPLE && \
            LIB_UTILS && LIB_SEL4_SIMPLE_DEFAULT && LIB_CPIO && LIB_SEL4_ARM_VMM && LIB_SEL4_SYNC && LIB_SEL4_DEBUG && \
            LIB_SEL4_DMA && LIB_USB
    default n
    select APP_CAMKES_EXECUTIVE

config CAMERA_VM_EMMC2_NODMA
    bool "SD access control to prevent DMA"
    depends on APP_CAMERA_VM
    default n
    help
        Installs SD card into the VM with read only access. Write access is
        trapped and emulated to ensure that DMA is not used.

config CAMERA_VM_VUSB
    bool "Para-virtual USB driver"
    depends on APP_CAMERA_VM
    help
        Selects the device tree which enables the para virtual USB driver and
        installs the device into the VM.

choice
    bool "root file system selection"
    depends on APP_CAMERA_VM
    default CAMERA_VM_ROOTFS_MMCBLK1P2
    help
        Selects the root device and partition which should be used for the
        root filesystem.

    config CAMERA_VM_ROOTFS_MMCBLK0P2
        bool "mmcblk0p2"
        help
            Selects partition 2 of the on board eMMC as the root filesystem.

    config CAMERA_VM_ROOTFS_MMCBLK1P2
        bool "mmcblk1p2"
        help
            Selects partition 2 of the on removable SD card as the root
            filesystem.

endchoice
```

## models/Trusted_Build_Test/camera_vm/make_template/Kconfig
```kconfig
config APP_CAMERA_VM
    bool "AADL generic message for implementation camera_vm"
    default n
    select APP_CAMKES_EXECUTIVE
    help
        AADL generic message for implementation camera_vm. 
```

## models/Trusted_Build_Test/camkes_timer/Kconfig
```kconfig
#
# Copyright 2014, NICTA
#
# This software may be distributed and modified according to the terms of
# the BSD 2-Clause license. Note that NO WARRANTY is provided.
# See "LICENSE_BSD2.txt" for details.
#
# @TAG(NICTA_BSD)
#

config APP_CAMKES_TIMER
    bool "CAmkES test of timer functionality"
    default n
    depends on ARCH_ARM
    select APP_CAMKES_EXECUTIVE
    help
        CAmkES test of timer functionality.
```

## models/Trusted_Build_Test/can/make_template/Kconfig
```kconfig
config APP_CAN
    bool "AADL generic message for implementation can"
    default n
    select APP_CAMKES_EXECUTIVE
    help
        AADL generic message for implementation can. 
```

## models/Trusted_Build_Test/ping_pong/Kconfig
```kconfig
config APP_PING_PONG
    bool "AADL generic message for implementation ping_pong"
    default n
    select APP_CAMKES_EXECUTIVE
    help
        AADL generic message for implementation ping_pong. 
```

## models/Trusted_Build_Test/test0/Kconfig
```kconfig
config APP_TEST0
    bool "AADL Test 0: single active periodic thread"
    default n
    select APP_CAMKES_EXECUTIVE
    help
        AADL Test 0: single active periodic thread. 
```

## models/Trusted_Build_Test/test1/Kconfig
```kconfig
config APP_TEST1
    bool "test1 (from AADL)"
    default n
    select APP_CAMKES_EXECUTIVE
    help
        test1 (from AADL).
```

## models/Trusted_Build_Test/test10/Kconfig
```kconfig
config APP_TEST10
    bool "test10 (from AADL)"
    default n
    select APP_CAMKES_EXECUTIVE
    help
        test10 (from AADL).
```

## models/Trusted_Build_Test/test11/Kconfig
```kconfig
config APP_TEST11
    bool "test11 (from AADL)"
    default n
    select APP_CAMKES_EXECUTIVE
    help
        test11 (from AADL).
```

## models/Trusted_Build_Test/test12/Kconfig
```kconfig
config APP_TEST12
    bool "test12 (from AADL)"
    default n
    select APP_CAMKES_EXECUTIVE
    help
        test12 (from AADL).
```

## models/Trusted_Build_Test/test13/Kconfig
```kconfig
config APP_TEST13
    bool "test13 (from AADL)"
    default n
    select APP_CAMKES_EXECUTIVE
    help
        test13 (from AADL).
```

## models/Trusted_Build_Test/test14/Kconfig
```kconfig
config APP_TEST14
    bool "test14 (from AADL)"
    default n
    select APP_CAMKES_EXECUTIVE
    help
        test14 (from AADL).
```

## models/Trusted_Build_Test/test15/Kconfig
```kconfig
config APP_TEST15
    bool "test15 (from AADL)"
    default n
    select APP_CAMKES_EXECUTIVE
    help
        test15 (from AADL).
```

## models/Trusted_Build_Test/test16/Kconfig
```kconfig
config APP_TEST16
    bool "test16 (from AADL)"
    default n
    select APP_CAMKES_EXECUTIVE
    help
        test16 (from AADL).
```

## models/Trusted_Build_Test/test16_shared_data/make_template/Kconfig
```kconfig
config APP_TEST16_SHARED_DATA
    bool "AADL generic message for implementation test16_shared_data"
    default n
    select APP_CAMKES_EXECUTIVE
    help
        AADL generic message for implementation test16_shared_data. 
```
