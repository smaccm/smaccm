## models/Trusted_Build_Test/test2/Kconfig
```kconfig
config APP_TEST2
    bool "test2 (from AADL)"
    default n
    select APP_CAMKES_EXECUTIVE
    help
        test2 (from AADL).
```

## models/Trusted_Build_Test/test20/Kconfig
```kconfig
config APP_TEST1
    bool "AADL Test 1: active -> passive threads using scalar send"
    default n
    select APP_CAMKES_EXECUTIVE
    help
        AADL Test 1: active -> passive threads using scalar send. 
```

## models/Trusted_Build_Test/test3/Kconfig
```kconfig
config APP_TEST3
    bool "test3 (from AADL)"
    default n
    select APP_CAMKES_EXECUTIVE
    help
        test3 (from AADL).
```

## models/Trusted_Build_Test/test4/Kconfig
```kconfig
config APP_TEST4
    bool "test4 (from AADL)"
    default n
    select APP_CAMKES_EXECUTIVE
    help
        test4 (from AADL).
```

## models/Trusted_Build_Test/test5/Kconfig
```kconfig
config APP_TEST5
    bool "test5 (from AADL)"
    default n
    select APP_CAMKES_EXECUTIVE
    help
        test5 (from AADL).
```

## models/Trusted_Build_Test/test6/Kconfig
```kconfig
config APP_TEST6
    bool "test6 (from AADL)"
    default n
    select APP_CAMKES_EXECUTIVE
    help
        test6 (from AADL).
```

## models/Trusted_Build_Test/test7/Kconfig
```kconfig
config APP_TEST7
    bool "test7 (from AADL)"
    default n
    select APP_CAMKES_EXECUTIVE
    help
        test7 (from AADL).
```

## models/Trusted_Build_Test/test8/Kconfig
```kconfig
config APP_TEST8
    bool "test8 (from AADL)"
    default n
    select APP_CAMKES_EXECUTIVE
    help
        test8 (from AADL).
```

## models/Trusted_Build_Test/test8/testing/camkes/Kconfig
```kconfig
#
# Copyright 2014, NICTA
#
# This software may be distributed and modified according to the terms of
# the BSD 2-Clause license. Note that NO WARRANTY is provided.
# See "LICENSE_BSD2.txt" for details.
#
# @TAG(NICTA_BSD)
#

mainmenu "CAmkES project configuration"

config COMMON_PATH
    string
    option env="COMMON_PATH"

menu "Kernel"
    source "kernel/Kconfig"
endmenu

menu "Libraries"
    source "libs/libmuslc/Kconfig"
    source "libs/libsel4/Kconfig"
    source "libs/libsel4muslcsys/Kconfig"
    source "libs/libsel4muslccamkes/Kconfig"
    source "libs/libsel4platsupport/Kconfig"
    source "libs/libsel4utils/Kconfig"
    source "libs/libcpio/Kconfig"
    source "libs/libelf/Kconfig"
    source "libs/libsel4bench/Kconfig"
    source "libs/libsel4sync/Kconfig"
    source "libs/libsel4vspace/Kconfig"
    source "libs/libsel4vka/Kconfig"
    source "libs/libplatsupport/Kconfig"
    source "libs/libsel4dma/Kconfig"
    source "libs/libsel4debug/Kconfig"
    source "libs/libutils/Kconfig"
    source "libs/libsel4simple/Kconfig"
    source "libs/libsel4simple-default/Kconfig"
    source "libs/libsel4arm-vmm/Kconfig"
    source "libs/libsel4allocman/Kconfig"
    source "libs/libusbdrivers/Kconfig"
    source "libs/libsel4vchan/Kconfig"
    source "libs/libsmaccmpilot/Kconfig"
    source "libs/libcan_proxy_odroid_test/Kconfig"
endmenu

menu "Applications"
    source "apps/capdl-loader-experimental/Kconfig"
#    source "apps/DARPA/Kconfig"
#    source "apps/test1/Kconfig"
#    source "apps/test2/Kconfig" 
#    source "apps/test3/Kconfig"
    source "apps/test8/Kconfig"
#    source "apps/test16/Kconfig"
#    source "apps/mailbox/Kconfig"
#    source "apps/test_diamond/Kconfig"
#    source "apps/test_initial_dispatch/Kconfig"
#    source "apps/vm/Kconfig"
#    source "apps/test_uart_active2/Kconfig"
#    source "apps/can/Kconfig"
    source "apps/timer_kzm/Kconfig"
#    source "apps/timer_odroid/Kconfig"
#    source "apps/vchan-test/Kconfig"
#    source "apps/vchan-test-aadl/Kconfig"
#    source "apps/can_proxy_odroid_test/Kconfig"
#    source "apps/camera_vm/Kconfig"
#    source "apps/smaccmpilot/Kconfig"
endmenu

source "tools/elfloader/Kconfig"
source "tools/camkes/Kconfig"
source "$COMMON_PATH/Kconfig"
```

## models/Trusted_Build_Test/test9/Kconfig
```kconfig
config APP_TEST9
    bool "test9 (from AADL)"
    default n
    select APP_CAMKES_EXECUTIVE
    help
        test9 (from AADL).
```

## models/Trusted_Build_Test/test_boeing1/Kconfig
```kconfig
config APP_TEST_BOEING1
    bool "AADL Test Boeing 1: active -> passive thread AADL RPC comm"
    default n
    select APP_CAMKES_EXECUTIVE
    help
        AADL Test Boeing 1: active -> passive thread AADL RPC comm 
```

## models/Trusted_Build_Test/test_boeing2/Kconfig
```kconfig
config APP_TEST_BOEING2
    bool "AADL Test Boeing 2: active -> passive thread AADL RPC comm w/harness"
    default n
    select APP_CAMKES_EXECUTIVE
    help
        AADL Test Boeing 1: active -> passive thread AADL RPC comm w/harness
```

## models/Trusted_Build_Test/test_irq1/Kconfig
```kconfig
config APP_TEST_IRQ1
    bool "AADL Test IRQ: active -> passive threads using struct send"
    default n
    select APP_CAMKES_EXECUTIVE
    help
        AADL Test IRQ: active -> passive threads using struct send. 
```

## models/Trusted_Build_Test/test_irq1_eChronos/Kconfig
```kconfig
config APP_TEST_IRQ1
    bool "AADL generic message for implementation test_irq1"
    default n
    select APP_CAMKES_EXECUTIVE
    help
        AADL generic message for implementation test_irq1. 
```

## models/Trusted_Build_Test/test_multiassembly/Kconfig
```kconfig
#
# Copyright 2014, NICTA
#
# This software may be distributed and modified according to the terms of
# the BSD 2-Clause license. Note that NO WARRANTY is provided.
# See "LICENSE_BSD2.txt" for details.
#
# @TAG(NICTA_BSD)
#

config APP_TEST_MULTIASSEMBLY
    bool "CAmkES application with multiple assembly blocks in multiple files"
    default n
    help
        An example of separating code into multiple assembly blocks
```

## models/Trusted_Build_Test/test_per/Kconfig
```kconfig
config APP_TEST_PER
    bool "AADL generic message for implementation test_per"
    default n
    select APP_CAMKES_EXECUTIVE
    help
        AADL generic message for implementation test_per. 
```

## models/Trusted_Build_Test/test_rpc_aadl/Kconfig
```kconfig
config APP_TEST_RPC_AADL
    bool "AADL Test RPC 1: active -> passive thread AADL RPC comm"
    default n
    select APP_CAMKES_EXECUTIVE
    help
        AADL Test RPC 1: active -> passive thread AADL RPC comm 
```

## models/Trusted_Build_Test/test_rpc_native/Kconfig
```kconfig
config APP_TEST_RPC_NATIVE
    bool "AADL Test RPC Native: active -> passive thread Native RPC comm"
    default n
    select APP_CAMKES_EXECUTIVE
    help
        AADL Test RPC Native: active -> passive thread Native RPC comm 
```

## models/Trusted_Build_Test/test_uart/Kconfig
```kconfig
config APP_TEST_UART
    bool "AADL generic message for implementation test_uart"
    default n
    select APP_CAMKES_EXECUTIVE
    help
        AADL generic message for implementation test_uart. 
```

## models/Trusted_Build_Test/test_uart_active/make_template/Kconfig
```kconfig
config APP_TEST_UART_ACTIVE
    bool "AADL generic message for implementation test_uart_active"
    default n
    select APP_CAMKES_EXECUTIVE
    help
        AADL generic message for implementation test_uart_active. 
```

## models/Trusted_Build_Test/test_uart_active2/Kconfig
```kconfig
config APP_TEST_UART_ACTIVE2
    bool "AADL generic message for implementation test_uart_active2"
    default n
    select APP_CAMKES_EXECUTIVE
    help
        AADL generic message for implementation test_uart_active2. 
```

## models/Trusted_Build_Test/udp/make_template/Kconfig
```kconfig
config APP_UDP
    bool "AADL generic message for implementation udp"
    default n
    select APP_CAMKES_EXECUTIVE
    help
        AADL generic message for implementation udp. 
```

## models/Trusted_Build_Test/vChan_demo/Kconfig
```kconfig
config APP_VCHAN_DEMO
    bool "AADL generic message for implementation vChan_demo"
    default n
    select APP_CAMKES_EXECUTIVE
    help
        AADL generic message for implementation vChan_demo. 
```

## models/smaccmpilot-tk1/Kconfig
```kconfig
config APP_SMACCMPILOT_TK1
    bool "Smaccmpilot for TK1"
    depends on LIB_SEL4 && LIB_MUSL_C && LIB_SEL4_VKA && LIB_SEL4_ALLOCMAN && LIB_SEL4_PLAT_SUPPORT && \
               LIB_PLATSUPPORT && LIB_SEL4_VSPACE && LIB_ELF && LIB_SEL4_UTILS && LIB_SEL4_SIMPLE && \
               LIB_UTILS && LIB_SEL4_SIMPLE_DEFAULT && LIB_CPIO && LIB_SEL4_ARM_VMM && LIB_SEL4_SYNC && LIB_SEL4_DEBUG && \
               LIB_SEL4_DMA && LIB_USB

    default n
    select TK1_DEVICE_FWD
    select APP_CAMKES_EXECUTIVE

choice
    bool "boot mode selection"
    depends on APP_SMACCMPILOT_TK1
    default VM_TK1_EMMC_ROOTFS
    help
        Selects whether to load root file system off emmc or ramdisk

    config VM_TK1_INITRD_ROOTFS
        bool "initrd"
        help
            Selects initrd as the root filesystem.

    config VM_TK1_EMMC_ROOTFS
        bool "mmcblk0p1"
        help
            Selects partition 1 of the emmc card as the root
            filesystem.
endchoice


config APP_SMACCMPILOT_TK1_TB_DEBUG
    bool "Enable debugging trusted build monitors"
    default n
    depends on APP_SMACCMPILOT_TK1 && PRINTING
    help
        Enable debugging trusted build monitors

config TK1_VM_HACK
    bool "Use hacked VM configuration (requires hand modifying capdl file)"
    default n
    depends on APP_SMACCMPILOT_TK1

config TK1_DEVICE_FWD
    bool
    default n
```
